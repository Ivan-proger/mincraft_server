## .lobby/plugins/SuperLobby/board.yml
```yaml
settings-enable: true
settings-update-title: 3
settings-world:
- world
- lobby
- hub
settings-title:
- '&7< &2&lPixel experience &7>'
board:
  line1:
    content:
    - ' '
    update: 1000
  line2:
    content:
    - '&a&lName: &7<player>'
    update: 120
  line3:
    content:
    - '                    '
    update: 1000
  line4:
    content:
    - '&a&lRank: &7User '
    update: 1000
  line5:
    content:
    - ' '
    update: 1000
  line6:
    content:
    - '&a&lCoins: &70 '
    update: 1000
  line7:
    content:
    - ' '
    update: 1000
  line8:
    content:
    - '&7ПОКУПАЙТЕ ДОНАТ ТОЛЬКО У НАС!'
    update: 10
```
